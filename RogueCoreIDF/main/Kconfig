## RogueCoreIDF/main/Kconfig
```kconfig
menu "RogueCore Options"

config ROGUECORE_AP_FALLBACK
    bool "Enable Wi-Fi AP fallback"
    default n

endmenu
```

## RogueCoreIDF/sdkconfig.defaults
```kconfig
CONFIG_PARTITION_TABLE_CUSTOM=y
CONFIG_PARTITION_TABLE_CUSTOM_FILENAME="partitions.csv"
CONFIG_PARTITION_TABLE_OFFSET=0x8000
CONFIG_APP_BUILD_TYPE_APP_2NDBOOT=y
CONFIG_ESPTOOLPY_FLASHSIZE_4MB=y
CONFIG_ESP_MAIN_TASK_STACK_SIZE=4096
CONFIG_FREERTOS_UNICORE=y
CONFIG_LOG_BOOTLOADER_LEVEL_INFO=y
CONFIG_LOG_DEFAULT_LEVEL_INFO=y
CONFIG_LITTLEFS_PAGE_SIZE=256
CONFIG_LITTLEFS_OBJ_NAME_LEN=32
```
